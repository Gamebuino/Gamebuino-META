//store the different sprites in PROGMEM to save RAM
const byte road[] PROGMEM = {  16,16,0x0,0x0,0x20,0x2,0x0,0x0,0x0,0x0,0x0,0x0,0x10,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0x0,};
const byte power_right[] PROGMEM = {  16,16,0x0,0x0,0x0,0x0,0x0,0xc0,0x0,0xa0,0x0,0x90,0x3f,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0x0,};
const byte power_down[] PROGMEM = {  16,16,0x0,0x0,0x0,0x0,0x7,0xe0,0x4,0x20,0x4,0x20,0x4,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0x0,};
const byte power_left[] PROGMEM = {  16,16,0x0,0x0,0x0,0x0,0x3,0x0,0x5,0x0,0x9,0x0,0x11,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0x0,};
const byte power_up[] PROGMEM = {  16,16,0x0,0x0,0x1,0x80,0x2,0x40,0x4,0x20,0x8,0x10,0x10,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0x0,};
const byte sand[] PROGMEM = {16,16,0x0,0x20,0x20,0x2,0x4,0x80,0x80,0x8,0x0,0x0,0x10,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0x80,};
const byte ice[] PROGMEM = {  16,16,0x0,0x0,0x4,0x10,0x8,0x20,0x10,0x40,0x20,0x80,0x41,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0x80,};
const byte start[] PROGMEM = {16,16,0x0,0x0,0x0,0x0,0x0,0x0,0x19,0x98,0x19,0x98,0x6,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0x0,};
const byte block_bouncer[] PROGMEM = {16,16,0xaa,0xaa,0x0,0x1,0x80,0x0,0xf,0xf1,0x9f,0xf8,0x1c,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0x55,};
const byte block_single[] PROGMEM = {  16,16,0xaa,0xaa,0x0,0x1,0x80,0x0,0xf,0xf1,0x9f,0xf8,0x1c,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0x55,};
const byte block_right[] PROGMEM = {  16,16,0xaa,0xaa,0x0,0x1,0x0,0x0,0xff,0xf1,0xff,0xf8,0x0,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0x55,};
const byte block_down[] PROGMEM = {  16,16,0x98,0x18,0x18,0x19,0x98,0x18,0x18,0x19,0x98,0x18,0x18,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0x55,};
const byte block_left[] PROGMEM = {  16,16,0xaa,0xaa,0x0,0x0,0x80,0x0,0xf,0xff,0x9f,0xff,0x1c,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0x55,};
const byte block_up[] PROGMEM = {  16,16,0xaa,0xaa,0x0,0x1,0x80,0x0,0xf,0xf1,0x9f,0xf8,0x1c,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0x19,};
const byte block_horizontal[] PROGMEM = {  16,16,0xaa,0xaa,0x0,0x0,0x0,0x0,0xff,0xff,0xff,0xff,0x0,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0x55,};
const byte block_vertical[] PROGMEM = {  16,16,0x98,0x18,0x18,0x19,0x98,0x18,0x18,0x19,0x98,0x18,0x18,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0x19,};

// array containing the different sprites
#define NUM_SPRITES 16
const byte* sprites[NUM_SPRITES] = {
  road,              //0
  power_right,       //1
  power_down,        //2
  power_left,        //3
  power_up,          //4
  sand,              //5
  ice,               //6
  start,             //7
  block_bouncer,     //8
  block_single,      //9
  block_right,       //A
  block_down,        //B
  block_left,        //C
  block_up,          //D
  block_horizontal,  //E
  block_vertical     //F
};


#define WORLD_W 32
#define WORLD_H 32
const byte world[WORLD_W*WORLD_H/2] PROGMEM = {
  0xDC,0xEE,0xEE,0xEE,0xEE,0xEE,0xEE,0xEE,0xEE,0xEE,0xEE,0xEE,0xEE,0xEE,0xEE,0xAD,
  0xF0,0x01,0x71,0x00,0x00,0x00,0x00,0xD0,0x00,0x00,0x0D,0xD0,0x00,0x00,0x05,0x5F,
  0xF0,0x0C,0xEE,0xEE,0xEE,0xEA,0x00,0xF0,0x0D,0x00,0x0F,0xF0,0x00,0x00,0x00,0x5F,
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  0xBC,0xEE,0xEE,0xEE,0xEE,0xEE,0xEE,0xEE,0xEE,0xEE,0xA8,0x88,0x88,0xCE,0xEE,0xAB,
};

byte getTile(byte x, byte y){
  if(x & 1)//odd
    return pgm_read_byte(world + y*(WORLD_W/2) + x/2) & B00001111;
  else //even
  return (pgm_read_byte(world + y*(WORLD_W/2) + x/2) >> 4);
}

void drawWorld(){
  for(byte y = max(0, (camera_y)/16); y < min(WORLD_W, (camera_y+LCDHEIGHT)/16+1); y++){
    for(byte x = max(0, (camera_x)/16); x < min(WORLD_H, (camera_x+LCDWIDTH)/16+1); x++){
      byte spriteID = getTile(x,y);
      //coordinates on the screen depending on the camera position
      int x_screen = x*16 - camera_x;
      int y_screen = y*16 - camera_y;
      gb.display.drawBitmap(x_screen, y_screen, sprites[spriteID]);
    }
  }
}

void drawMap(){
  gb.display.fillRect(0,0,18,18);
  gb.display.setColor(WHITE);
  for(byte y = 0; y < 16; y++){
    for(byte x = 0; x < 16; x++){
      char tile_x = x + player.x/16 - 8;
      char tile_y = y + player.y/16 - 8;
      if(tile_x < 0 || tile_x > WORLD_W || tile_y < 0 || tile_y > WORLD_H)
        continue;
      if(getTile(tile_x, tile_y) < 8)
        gb.display.drawPixel(x+1, y+1);
    }
  }
  gb.display.setColor(BLACK);
  gb.display.drawPixel(9,9);
}



